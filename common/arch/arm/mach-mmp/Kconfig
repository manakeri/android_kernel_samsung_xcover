## common/arch/arm/mach-mmp/Kconfig
```kconfig
if ARCH_MMP

menu "Marvell PXA168/910/MMP2/MMP3 Implmentations"

config MACH_ASPENITE
	bool "Marvell's PXA168 Aspenite Development Board"
	select CPU_PXA168
	help
	  Say 'Y' here if you want to support the Marvell PXA168-based
	  Aspenite Development Board.

config MACH_ZYLONITE2
	bool "Marvell's PXA168 Zylonite2 Development Board"
	select CPU_PXA168
	help
	  Say 'Y' here if you want to support the Marvell PXA168-based
	  Zylonite2 Development Board.

config MACH_AVENGERS_LITE
	bool "Marvell's PXA168 Avengers Lite Development Board"
	select CPU_PXA168
	help
	  Say 'Y' here if you want to support the Marvell PXA168-based
	  Avengers Lite Development Board.

config MACH_TAVOREVB
	bool "Marvell's PXA910 TavorEVB Development Board"
	select CPU_PXA910
	help
	  Say 'Y' here if you want to support the Marvell PXA910-based
	  TavorEVB Development Board.

config MACH_TTC_DKB
	bool "Marvell's PXA910 TavorEVB Development Board"
	select CPU_PXA910
	help
	  Say 'Y' here if you want to support the Marvell PXA910-based
	  TTC_DKB Development Board.

config MACH_BROWNSTONE
	bool "Marvell's Brownstone Development Platform"
	select CPU_MMP2
	help
	  Say 'Y' here if you want to support the Marvell MMP2-based
	  Flint Development Platform.
	  MMP2-based board can't be co-existed with PXA168-based &
	  PXA910-based development board. Since MMP2 is compatible to
	  ARMv7 architecture.

config MACH_FLINT
	bool "Marvell's Flint Development Platform"
	select CPU_MMP2
	help
	  Say 'Y' here if you want to support the Marvell MMP2-based
	  Flint Development Platform.
	  MMP2-based board can't be co-existed with PXA168-based &
	  PXA910-based development board. Since MMP2 is compatible to
	  ARMv7 architecture.

config MACH_MARVELL_JASPER
	bool "Marvell's Jasper Development Platform"
	select CPU_MMP2
	help
	  Say 'Y' here if you want to support the Marvell MMP2-base
	  Jasper Development Platform.
	  MMP2-based board can't be co-existed with PXA168-based &
	  PXA910-based development board. Since MMP2 is compatible to
	  ARMv7 architecture.

config MACH_ABILENE
	bool "Marvell's MMP3 Abliene Development Board"
	select CPU_MMP3
	select HAVE_PWM

endmenu

choice
	prompt "MMP3 core:"
	depends on CPU_MMP3
	default CPU_PJ4B_V7

config	CPU_PJ4B_V6
	bool "Marvell PJ4B V6"
	select CPU_V6
	select CPU_32v6K

config CPU_PJ4B_V7
	bool "Marvell PJ4B V7"
	select CPU_V7
	select ARM_THUMBEE

endchoice

config GLOBAL_PREEMPT_NOTIFIERS
	bool "Enable global preempt notifier"
	depends on PREEMPT_NOTIFIERS
	default y

config CPU_PXA168
	bool
	select CPU_MOHAWK
	select PREEMPT_NOTIFIERS
	help
	  Select code specific to PXA168

config CPU_PXA910
	bool
	select CPU_MOHAWK
	select PREEMPT_NOTIFIERS
	help
	  Select code specific to PXA910

config CPU_MMP2
	bool
	select CPU_PJ4 if !CPU_MONAWK
	select PREEMPT_NOTIFIERS
	help
	  Select code specific to MMP2. MMP2 is ARMv7 compatible.

config CPU_MMP3
	 bool
	 select CPU_PJ4B
	 select ARM_GIC
	 select PREEMPT_NOTIFIERS
	 help
	   Select code specific to MMP3.

config PXA_RAMDUMP
	bool "RAMDUMP debug capability"

config PXA921_DKB
	bool "PXA921 DKB"
	help
		use different PPs on PXA921 boards
endif
```

## common/arch/arm/plat-pxa/Kconfig
```kconfig
if PLAT_PXA

config PXA_SSP
	tristate
	help
	  Enable support for PXA2xx SSP ports

config PXA_VBUS
	tristate
        default y
	help
	  Enable support for PXA VBUS

config PXA_32KTIMER
	bool "PXA 32K Timer"
	depends on (ARCH_PXA || ARCH_MMP)
	help
	  32KHz timer support for PXA27x and PXA3xx/9xx Processor

config PXA_MFP_CFG_BITS
	bool "PXA MFP_CFG per bit support"
	depends on ARCH_PXA
	default n
	help
	  By enabling this option the mfp_config() call when is used with
	  MFP_CFG_ to compose its first parameter will affect the desired bits
	  only. Otherwise, the whole MFPR value will be overwritten
	  The maintainer of each board should decide either to stick to the old
	  MFP_CFG_ behavior, so all legacy MFPR configurations in the board
	  specific code will not be changed or switch to the new MFP_CFG_, which
	  provides bit granularity access and in this case all legacy mfp_config()
	  calls will affect explicitly specified MFPR bits only.

endif
```

## common/drivers/i2c/chips/Kconfig
```kconfig
#
# Miscellaneous I2C chip drivers configuration
#
# *** DEPRECATED! Do not add new entries! See Makefile ***
#

menu "Miscellaneous I2C Chip support"

config SENSORS_ATMEL_AT42QT
	boolean "Atmel AT42QTXXXX Touch"
	depends on I2C && I2C_PXA95x
	default y
	help
	  Atmel AT42QTXXXX is a Touch chip.
	  If you say yes here, you support for it.

endmenu
```

## common/drivers/video/display/Kconfig
```kconfig
#
# Display drivers configuration
#

menu "Display device support"

config DISPLAY_SUPPORT
	tristate "Display panel/monitor support"
	---help---
	  This framework adds support for low-level control of a display.
	  This includes support for power.

	  Enable this to be able to choose the drivers for controlling the
	  physical display panel/monitor on some platforms. This not only
	  covers LCD displays for PDAs but also other types of displays
	  such as CRT, TVout etc.

	  To have support for your specific display panel you will have to
	  select the proper drivers which depend on this option.

comment "Display hardware drivers"
	depends on DISPLAY_SUPPORT

config LCD_S6D05A0X
	tristate "lcd s6d05a0x type"
	depends on y
	default n
	help
        LCD setting s6d05a0x.


config LCD_S6D04D1X21
	tristate "lcd s6d04d1x21 type"
	depends on y
	default n
	help
        LCD setting s6d04d1x21.

config LCD_ILI9486
	tristate "lcd ili9486 type"
	depends on y
	default n
	help
        LCD setting ili9486.
        
 config LCD_DB7431
	tristate "lcd db7431 type"
	depends on y
	default n
	help
        LCD setting db7431.
        
 config LCD_FOR_ALKON_REV02
 	tristate "lcd interface change"
	depends on y
	default n
	help
        LCD interface.

config LCD_ESD_CHECK
	tristate "lcd esd check routine"
	depends on y
	default n
	help
        LCD ESD check routine.		

        
endmenu
```

## common/sound/soc/pxa/Kconfig
```kconfig
config SND_PXA2XX_SOC
	tristate "SoC Audio for the Intel PXA2xx chip"
	depends on ARCH_PXA
	select SND_PXA2XX_LIB
	help
	  Say Y or M if you want to add support for codecs attached to
	  the PXA2xx AC97, I2S or SSP interface. You will also need
	  to select the audio interfaces to support below.

config SND_PXA2XX_AC97
	tristate
	select SND_AC97_CODEC

config SND_PXA2XX_SOC_AC97
	tristate
	select AC97_BUS
	select SND_ARM
	select SND_PXA2XX_LIB_AC97
	select SND_SOC_AC97_BUS

config SND_PXA2XX_SOC_I2S
	tristate

config SND_PXA_SOC_SSP
	tristate
	select PXA_SSP

config SND_PXA2XX_SOC_CORGI
	tristate "SoC Audio support for Sharp Zaurus SL-C7x0"
	depends on SND_PXA2XX_SOC && PXA_SHARP_C7xx
	select SND_PXA2XX_SOC_I2S
	select SND_SOC_WM8731
	help
	  Say Y if you want to add support for SoC audio on Sharp
	  Zaurus SL-C7x0 models (Corgi, Shepherd, Husky).

config SND_PXA2XX_SOC_SPITZ
	tristate "SoC Audio support for Sharp Zaurus SL-Cxx00"
	depends on SND_PXA2XX_SOC && PXA_SHARP_Cxx00
	select SND_PXA2XX_SOC_I2S
	select SND_SOC_WM8750
	help
	  Say Y if you want to add support for SoC audio on Sharp
	  Zaurus SL-Cxx00 models (Spitz, Borzoi and Akita).

config SND_PXA2XX_SOC_Z2
	tristate "SoC Audio support for Zipit Z2"
	depends on SND_PXA2XX_SOC && MACH_ZIPIT2
	select SND_PXA2XX_SOC_I2S
	select SND_SOC_WM8750
	help
	  Say Y if you want to add support for SoC audio on Zipit Z2.

config SND_PXA2XX_SOC_POODLE
	tristate "SoC Audio support for Poodle"
	depends on SND_PXA2XX_SOC && MACH_POODLE
	select SND_PXA2XX_SOC_I2S
	select SND_SOC_WM8731
	help
	  Say Y if you want to add support for SoC audio on Sharp
	  Zaurus SL-5600 model (Poodle).

config SND_PXA2XX_SOC_TOSA
	tristate "SoC AC97 Audio support for Tosa"
	depends on SND_PXA2XX_SOC && MACH_TOSA
	depends on MFD_TC6393XB
	select SND_PXA2XX_SOC_AC97
	select SND_SOC_WM9712
	help
	  Say Y if you want to add support for SoC audio on Sharp
	  Zaurus SL-C6000x models (Tosa).

config SND_PXA2XX_SOC_E740
	tristate "SoC AC97 Audio support for e740"
	depends on SND_PXA2XX_SOC && MACH_E740
	select SND_SOC_WM9705
	select SND_PXA2XX_SOC_AC97
	help
	  Say Y if you want to add support for SoC audio on the
	  toshiba e740 PDA

config SND_PXA2XX_SOC_E750
	tristate "SoC AC97 Audio support for e750"
	depends on SND_PXA2XX_SOC && MACH_E750
	select SND_SOC_WM9705
	select SND_PXA2XX_SOC_AC97
	help
	  Say Y if you want to add support for SoC audio on the
	  toshiba e750 PDA

config SND_PXA2XX_SOC_E800
	tristate "SoC AC97 Audio support for e800"
	depends on SND_PXA2XX_SOC && MACH_E800
	select SND_SOC_WM9712
	select SND_PXA2XX_SOC_AC97
	help
	  Say Y if you want to add support for SoC audio on the
	  Toshiba e800 PDA

config SND_PXA2XX_SOC_EM_X270
	tristate "SoC Audio support for CompuLab EM-x270, eXeda and CM-X300"
	depends on SND_PXA2XX_SOC && (MACH_EM_X270 || MACH_EXEDA || \
			MACH_CM_X300)
	select SND_PXA2XX_SOC_AC97
	select SND_SOC_WM9712
	help
	  Say Y if you want to add support for SoC audio on
	  CompuLab EM-x270, eXeda and CM-X300 machines.

config SND_PXA2XX_SOC_PALM27X
	bool "SoC Audio support for Palm T|X, T5, E2 and LifeDrive"
	depends on SND_PXA2XX_SOC && (MACH_PALMLD || MACH_PALMTX || \
			MACH_PALMT5 || MACH_PALMTE2)
	select SND_PXA2XX_SOC_AC97
	select SND_SOC_WM9712
	help
	  Say Y if you want to add support for SoC audio on
	  Palm T|X, T5, E2 or LifeDrive handheld computer.

config SND_SOC_ZYLONITE
	tristate "SoC Audio support for Marvell Zylonite"
	depends on SND_PXA2XX_SOC && MACH_ZYLONITE
	select SND_PXA2XX_SOC_AC97
	select SND_PXA_SOC_SSP
	select SND_SOC_WM9713
	help
	  Say Y if you want to add support for SoC audio on the
	  Marvell Zylonite reference platform.

config SND_SOC_RAUMFELD
	tristate "SoC Audio support Raumfeld audio adapter"
	depends on SND_PXA2XX_SOC && (MACH_RAUMFELD_SPEAKER || MACH_RAUMFELD_CONNECTOR)
	select SND_PXA_SOC_SSP
	select SND_SOC_CS4270
	select SND_SOC_AK4104
	help
	  Say Y if you want to add support for SoC audio on Raumfeld devices

config SND_PXA2XX_SOC_MAGICIAN
	tristate "SoC Audio support for HTC Magician"
	depends on SND_PXA2XX_SOC && MACH_MAGICIAN
	select SND_PXA2XX_SOC_I2S
	select SND_PXA_SOC_SSP
	select SND_SOC_UDA1380
	help
	  Say Y if you want to add support for SoC audio on the
	  HTC Magician.

config SND_PXA2XX_SOC_MIOA701
        tristate "SoC Audio support for MIO A701"
        depends on SND_PXA2XX_SOC && MACH_MIOA701
        select SND_PXA2XX_SOC_AC97
        select SND_SOC_WM9713
        help
          Say Y if you want to add support for SoC audio on the
          MIO A701.

config SND_PXA2XX_SOC_IMOTE2
       tristate "SoC Audio support for IMote 2"
       depends on SND_PXA2XX_SOC && MACH_INTELMOTE2 && I2C
       select SND_PXA2XX_SOC_I2S
       select SND_SOC_WM8940
       help
         Say Y if you want to add support for SoC audio on the
	 IMote 2.

config SND_PXA3XX_SOC_SSP
	bool "Soc Audio for the Intel PXA3xx SSP interface"
	depends on ARCH_MMP && SND
        help
	  Say Y or M if you want to add support for PXA3xx ssp interface.

menu "SoC Audio for the Marvell PXA910"
config SND_PXA910_SOC
	tristate "SoC Audio for the Marvell PXA910 chip"
	depends on ARCH_MMP && SND
	select SND_PCM
	help
	  Say Y or M if you want to add support for codecs attached to
	  the PXA3xx AC97, I2S or SSP interface. You will also need
	  to select the audio interfaces to support below.

config SND_PXA910_SOC_TTC_DKB
        bool "SoC Audio support for TTC DKB"
	depends on SND_PXA910_SOC && MACH_TTC_DKB
	select PXA_SSP
	select SND_PXA3XX_SOC_SSP
	select SND_SOC_88PM860X_AUDIO
	help
	  Say Y if you want to add support for SoC audio on TTC DKB

endmenu

menu "SoC Audio for the Marvell PXA95x"
config SND_PXA95X_SOC
	tristate "SoC Audio for the Marvell PXA95x chip"
	depends on PXA95x && SND
	select SND_PCM
	select SND_PXA3XX_SOC_SSP
	select SND_PXA95X_SOC_ABU
	help
	  Say Y or M if you want to add support for codecs attached to
	  the PXA3xx AC97, I2S or SSP interface. You will also need
	  to select the audio interfaces to support below.

config SND_PXA95X_SOC_SAARB_MG1
        bool "SoC Audio support for SAARB"
	depends on SND_PXA95X_SOC && (MACH_TAVOREVB3_MG1||MACH_SAARB_MG1||MACH_NEVOEVB3||MACH_GFORCE||MACH_ALKON)
	select SND_SOC_88PM860X_AUDIO
	select SND_SOC_HDMI_AUDIO
	help
	  Say Y if you want to add support for SoC audio on TavorEVB3 MG1 or SaarB_MG1

config SND_PXA95X_SOC_SAARC_MG2
	bool "SoC Audio support for SAARC"
	depends on SND_PXA95X_SOC && MACH_SAARC_MG2
	select SND_SOC_88PM860X_AUDIO
	select SND_SOC_HDMI_AUDIO
	help
	  Say Y if you want to add support for SoC audio on SaarC MG2

config SND_PXA95X_SOC_SAARB_D1981_MG1
        bool "SoC Audio support for SAARB"
	depends on SND_PXA95X_SOC && (MACH_TAVOREVB3_MG1||MACH_SAARB_MG1||MACH_NEVOEVB3||MACH_GFORCE||MACH_JETTA)
	select SND_SOC_D1981
	select SND_SOC_HDMI_AUDIO
	help
	  Say Y if you want to add support for SoC audio on TavorEVB3 MG1 or SaarB_MG1

config SND_PXA95X_SOC_SAARC_D1981_MG2
	bool "SoC Audio support for SAARC"
	depends on SND_PXA95X_SOC && MACH_SAARC_MG2
	select SND_SOC_D1981
	select SND_SOC_HDMI_AUDIO
	help
	  Say Y if you want to add support for SoC audio on SaarC MG2

config SND_PXA95X_SOC_ABU
	bool

endmenu

menu "SoC Audio for the Marvell MMPx"
config SND_MMP3_SOC
	tristate "SoC Audio for the Marvell MMPx chip"
	depends on ARCH_MMP && SND
	select SND_PCM
	help
	  Say Y or M if you want to add support for codecs attached to
	  the MMP3 AC97, I2S, SSP or SSPA interface. You will also need
	  to select the audio interfaces to support below.

config SND_MMP3_SOC_ABILENE
        bool "SoC Audio support for MMP3 ABILENE"
	depends on SND_MMP3_SOC && MACH_ABILENE
	select SND_SOC_WM8994
	help
	  Say Y if you want to add support for SoC audio on TTC DKB

config SND_WM8994_MASTER_MODE
        bool "Audio wm8994 master mode"
	depends on SND_MMP3_SOC_ABILENE
	select SND_SOC_WM8994
	help
	  Say Y if you want to add support for SoC audio master mode on MMP2

config SND_WM8994_SLAVE_MODE
        bool "Audio wm8994 slave mode"
	depends on SND_MMP3_SOC_ABILENE
	select SND_SOC_WM8994
	help
	  Say Y if you want to add support for SoC audio slave mode on MMP2

endmenu
```
